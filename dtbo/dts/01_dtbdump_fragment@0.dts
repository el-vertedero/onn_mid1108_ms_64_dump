/dts-v1/;

/ {

	fragment@0 {
		target = <0xffffffff>;

		__overlay__ {

			cam0@0 {
				phandle = <0x02>;

				pins_cmd_dat {
					pinmux = <0x1400>;
					slew-rate = <0x01>;
					output-low;
				};
			};

			cam0@1 {
				phandle = <0x03>;

				pins_cmd_dat {
					pinmux = <0x1400>;
					slew-rate = <0x01>;
					output-high;
				};
			};

			cam0@2 {
				phandle = <0x04>;

				pins_cmd_dat {
					pinmux = <0x1300>;
					slew-rate = <0x01>;
					output-low;
				};
			};

			cam0@3 {
				phandle = <0x05>;

				pins_cmd_dat {
					pinmux = <0x1300>;
					slew-rate = <0x01>;
					output-high;
				};
			};

			cam0@vcama0 {
				phandle = <0x06>;

				pins_cmd_dat {
					pinmux = <0x9900>;
					slew-rate = <0x01>;
					output-low;
				};
			};

			cam0@vcamd1 {
				phandle = <0x07>;

				pins_cmd_dat {
					pinmux = <0x9900>;
					slew-rate = <0x01>;
					output-high;
				};
			};

			cam0@vcamaf0 {
				phandle = <0x08>;

				pins_cmd_dat {
					pinmux = <0x9700>;
					slew-rate = <0x01>;
					output-low;
				};
			};

			cam0@vcamaf1 {
				phandle = <0x09>;

				pins_cmd_dat {
					pinmux = <0x9700>;
					slew-rate = <0x01>;
					output-high;
				};
			};

			cam1@0 {
				phandle = <0x0a>;

				pins_cmd_dat {
					pinmux = <0x1000>;
					slew-rate = <0x01>;
					output-low;
				};
			};

			cam1@1 {
				phandle = <0x0b>;

				pins_cmd_dat {
					pinmux = <0x1000>;
					slew-rate = <0x01>;
					output-high;
				};
			};

			cam1@2 {
				phandle = <0x0c>;

				pins_cmd_dat {
					pinmux = <0x1500>;
					slew-rate = <0x01>;
					output-low;
				};
			};

			cam1@3 {
				phandle = <0x0d>;

				pins_cmd_dat {
					pinmux = <0x1500>;
					slew-rate = <0x01>;
					output-high;
				};
			};

			cam1@vcama0 {
				phandle = <0x0e>;

				pins_cmd_dat {
					pinmux = <0x9900>;
					slew-rate = <0x01>;
					output-low;
				};
			};

			cam1@vcama1 {
				phandle = <0x0f>;

				pins_cmd_dat {
					pinmux = <0x9900>;
					slew-rate = <0x01>;
					output-high;
				};
			};

			camera_pins_cam0_mclk_off {
				phandle = <0x10>;

				pins_cmd_dat {
					pinmux = <0x8000>;
					drive-strength = <0x01>;
				};
			};

			camera_pins_cam0_mclk_2ma {
				phandle = <0x11>;

				pins_cmd_dat {
					pinmux = <0x8001>;
					drive-strength = <0x00>;
				};
			};

			camera_pins_cam0_mclk_4ma {
				phandle = <0x12>;

				pins_cmd_dat {
					pinmux = <0x8001>;
					drive-strength = <0x01>;
				};
			};

			camera_pins_cam0_mclk_6ma {
				phandle = <0x13>;

				pins_cmd_dat {
					pinmux = <0x8001>;
					drive-strength = <0x02>;
				};
			};

			camera_pins_cam0_mclk_8ma {
				phandle = <0x14>;

				pins_cmd_dat {
					pinmux = <0x8001>;
					drive-strength = <0x03>;
				};
			};

			camera_pins_cam1_mclk_off {
				phandle = <0x15>;

				pins_cmd_dat {
					pinmux = <0x7e00>;
					drive-strength = <0x01>;
				};
			};

			camera_pins_cam1_mclk_2ma {
				phandle = <0x16>;

				pins_cmd_dat {
					pinmux = <0x7e01>;
					drive-strength = <0x00>;
				};
			};

			camera_pins_cam1_mclk_4ma {
				phandle = <0x17>;

				pins_cmd_dat {
					pinmux = <0x7e01>;
					drive-strength = <0x01>;
				};
			};

			camera_pins_cam1_mclk_6ma {
				phandle = <0x18>;

				pins_cmd_dat {
					pinmux = <0x7e01>;
					drive-strength = <0x02>;
				};
			};

			camera_pins_cam1_mclk_8ma {
				phandle = <0x19>;

				pins_cmd_dat {
					pinmux = <0x7e01>;
					drive-strength = <0x03>;
				};
			};

			camdefault {
				phandle = <0x01>;
			};
		};
	};

	fragment@1 {
		target = <0xffffffff>;

		__overlay__ {
			pinctrl-names = "default\0cam0_rst0\0cam0_rst1\0cam0_pnd0\0cam0_pnd1\0cam0_ldo_vcama_0\0cam0_ldo_vcama_1\0cam0_ldo_vcamaf_0\0cam0_ldo_vcamaf_1\0cam1_rst0\0cam1_rst1\0cam1_pnd0\0cam1_pnd1\0cam1_ldo_vcama_0\0cam1_ldo_vcama_1\0cam0_mclk_off\0cam0_mclk_2mA\0cam0_mclk_4mA\0cam0_mclk_6mA\0cam0_mclk_8mA\0cam1_mclk_off\0cam1_mclk_2mA\0cam1_mclk_4mA\0cam1_mclk_6mA\0cam1_mclk_8mA";
			pinctrl-0 = <0x01>;
			pinctrl-1 = <0x02>;
			pinctrl-2 = <0x03>;
			pinctrl-3 = <0x04>;
			pinctrl-4 = <0x05>;
			pinctrl-5 = <0x06>;
			pinctrl-6 = <0x07>;
			pinctrl-7 = <0x08>;
			pinctrl-8 = <0x09>;
			pinctrl-9 = <0x0a>;
			pinctrl-10 = <0x0b>;
			pinctrl-11 = <0x0c>;
			pinctrl-12 = <0x0d>;
			pinctrl-13 = <0x0e>;
			pinctrl-14 = <0x0f>;
			pinctrl-15 = <0x10>;
			pinctrl-16 = <0x11>;
			pinctrl-17 = <0x12>;
			pinctrl-18 = <0x13>;
			pinctrl-19 = <0x14>;
			pinctrl-20 = <0x15>;
			pinctrl-21 = <0x16>;
			pinctrl-22 = <0x17>;
			pinctrl-23 = <0x18>;
			pinctrl-24 = <0x19>;
			cam0_vcamio-supply = <0xffffffff>;
			cam0_vcamd-supply = <0xffffffff>;
			cam1_vcamio-supply = <0xffffffff>;
			cam1_vcamd-supply = <0xffffffff>;
			cam0_pin_mclk = "mclk";
			cam0_pin_rst = "gpio";
			cam0_pin_pdn = "gpio";
			cam0_pin_vcama = "gpio";
			cam0_pin_vcamio = "regulator";
			cam0_pin_vcamd = "regulator";
			cam0_pin_vcamaf = "gpio";
			cam1_pin_mclk = "mclk";
			cam1_pin_rst = "gpio";
			cam1_pin_pdn = "gpio";
			cam1_pin_vcama = "gpio";
			cam1_pin_vcamio = "regulator";
			cam1_pin_vcamd = "regulator";
			status = "okay";
		};
	};

	fragment@2 {
		target = <0xffffffff>;

		__overlay__ {
			status = "okay";
			clock-frequency = <0x61a80>;
			#address-cells = <0x01>;
			#size-cells = <0x00>;

			camera_sub@1a {
				compatible = "mediatek,camera_sub";
				#thermal-sensor-cells = <0x00>;
				reg = <0x1a>;
				status = "okay";
				phandle = <0x1b>;
			};
		};
	};

	fragment@3 {
		target = <0xffffffff>;

		__overlay__ {
			status = "okay";
			clock-frequency = <0x61a80>;
			#address-cells = <0x01>;
			#size-cells = <0x00>;

			camera_main@1a {
				compatible = "mediatek,camera_main";
				#thermal-sensor-cells = <0x00>;
				reg = <0x1a>;
				status = "okay";
				phandle = <0x1a>;
			};

			camera_main_af@51 {
				compatible = "mediatek,CAMERA_MAIN_AF";
				reg = <0x51>;
				status = "okay";
				phandle = <0x40>;
			};
		};
	};

	fragment@4 {
		target = <0xffffffff>;

		__overlay__ {

			camera_main {
				polling-delay = <0x3e8>;
				polling-delay-passive = <0x00>;
				thermal-sensors = <0x1a>;
				phandle = <0x41>;
			};

			camera_sub {
				polling-delay = <0x3e8>;
				polling-delay-passive = <0x00>;
				thermal-sensors = <0x1b>;
				phandle = <0x42>;
			};
		};
	};

	fragment@5 {
		target = <0xffffffff>;

		__overlay__ {
		};
	};

	fragment@6 {
		target = <0xffffffff>;

		__overlay__ {
			hardware = "mt8781";
		};
	};

	fragment@7 {
		target = <0xffffffff>;

		__overlay__ {
			compatible = "mediatek,pwm-leds";

			backlight {
				led_mode = <0x05>;
				gate_enable = <0x00>;
				pwm_config = <0x00 0x01 0x00 0x00 0x00>;
				pwms = <0xffffffff 0x00 0x99d9>;
				pwm-names = "lcd-backlight";
				max-brightness = <0xff>;
				max-hw-brightness = <0x3ff>;
				default-state = "half";
			};
		};
	};

	fragment@8 {
		target = <0xffffffff>;

		__overlay__ {

			lcm_led_en1_gpio {
				phandle = <0x1c>;

				pins_cmd_dat {
					pinmux = <0xc00>;
					slew-rate = <0x01>;
					output-high;
				};
			};

			lcm_led_en0_gpio {
				phandle = <0x1d>;

				pins_cmd_dat {
					pinmux = <0xc00>;
					slew-rate = <0x01>;
					output-low;
				};
			};

			lcm_rst_out1_gpio {
				phandle = <0x1e>;

				pins_cmd_dat {
					pinmux = <0x5500>;
					slew-rate = <0x01>;
					output-high;
				};
			};

			lcm_rst_out0_gpio {
				phandle = <0x1f>;

				pins_cmd_dat {
					pinmux = <0x5500>;
					slew-rate = <0x01>;
					output-low;
				};
			};

			lcm_dsi_te {
				phandle = <0x20>;

				pins_cmd_dat {
					pinmux = <0x5301>;
				};
			};
		};
	};

	fragment@9 {
		target = <0xffffffff>;

		__overlay__ {
			pinctrl-names = "lcm_led_en1_gpio\0lcm_led_en0_gpio\0lcm_rst_out1_gpio\0lcm_rst_out0_gpio\0mode_te_te";
			pinctrl-0 = <0x1c>;
			pinctrl-1 = <0x1d>;
			pinctrl-2 = <0x1e>;
			pinctrl-3 = <0x1f>;
			pinctrl-4 = <0x20>;
			status = "okay";
		};
	};

	fragment@10 {
		target = <0xffffffff>;

		__overlay__ {
			pinctrl-names = "lcm_rst_out1_gpio\0lcm_rst_out0_gpio\0mode_te_te";
			pinctrl-0 = <0x1e>;
			pinctrl-1 = <0x1f>;
			pinctrl-2 = <0x20>;
			status = "okay";
		};
	};

	fragment@11 {
		target = <0xffffffff>;

		__overlay__ {

			lp62701@3e {
				compatible = "gateic,lp62701";
				reg = <0x3e>;
				status = "okay";
				phandle = <0x21>;
			};
		};
	};

	fragment@12 {
		target = <0xffffffff>;

		__overlay__ {
			status = "okay";
			#address-cells = <0x01>;
			#size-cells = <0x00>;

			panel1@0 {
				compatible = "hjr,110016d_a0,vdo";
				reg = <0x00>;
				iovcc-supply = <0xffffffff>;
				reset-gpios = <0xffffffff 0x55 0x00>;
				biasen-gpios = <0xffffffff 0x96 0x00>;
				bl-gpios = <0xffffffff 0x9d 0x00>;
				gate-ic = <0x21>;
				rotation = <0x10e>;

				port {

					endpoint {
						remote-endpoint = <0x22>;
						phandle = <0x23>;
					};
				};
			};

			panel2@1 {
				compatible = "hjr,110018d_a0,vdo";
				reg = <0x01>;
				iovcc-supply = <0xffffffff>;
				reset-gpios = <0xffffffff 0x55 0x00>;
				biasen-gpios = <0xffffffff 0x96 0x00>;
				bl-gpios = <0xffffffff 0x9d 0x00>;
				gate-ic = <0x21>;
				rotation = <0x10e>;
				override_max_brightness = <0x125>;
				firmware = "HJR110068D_HW_D00_C53_20231221_055922.bin";

				port {

					endpoint {
						remote-endpoint = <0x22>;
						phandle = <0x43>;
					};
				};
			};

			ports {

				port {

					endpoint {
						remote-endpoint = <0x23>;
						phandle = <0x22>;
					};
				};
			};
		};
	};

	fragment@13 {
		target = <0xffffffff>;

		__overlay__ {

			gps_default {
				phandle = <0x24>;
			};

			gps_l1_lna@0 {
				phandle = <0x25>;

				pins_cmd_dat {
					pinmux = <0x1900>;
					output-low;
				};
			};

			gps_l1_lna@1 {
				phandle = <0x26>;

				pins_cmd_dat {
					pinmux = <0x1902>;
				};
			};

			gps_l1_lna@2 {
				phandle = <0x27>;

				pins_cmd_dat {
					pinmux = <0x1900>;
					output-high;
				};
			};

			gps_l5_lna@0 {
				phandle = <0x28>;

				pins_cmd_dat {
					pinmux = <0x1a00>;
					output-low;
				};
			};

			gps_l5_lna@1 {
				phandle = <0x29>;

				pins_cmd_dat {
					pinmux = <0x1a02>;
				};
			};

			gps_l5_lna@2 {
				phandle = <0x2a>;

				pins_cmd_dat {
					pinmux = <0x1a00>;
					output-high;
				};
			};
		};
	};

	fragment@14 {
		target = <0xffffffff>;

		__overlay__ {
			pinctrl-names = "default\0gps_l1_lna_disable\0gps_l1_lna_dsp_ctrl\0gps_l1_lna_enable\0gps_l5_lna_disable\0gps_l5_lna_dsp_ctrl\0gps_l5_lna_enable";
			pinctrl-0 = <0x24>;
			pinctrl-1 = <0x25>;
			pinctrl-2 = <0x26>;
			pinctrl-3 = <0x27>;
			pinctrl-4 = <0x28>;
			pinctrl-5 = <0x29>;
			pinctrl-6 = <0x2a>;
			status = "okay";
		};
	};

	fragment@15 {
		target = <0xffffffff>;

		__overlay__ {
			clock-frequency = <0x61a80>;
			pinctrl-names = "default\0ts_int_active\0ts_reset_active\0ts_int_suspend\0ts_reset_suspend\0ts_i2c_mode";
			pinctrl-0 = <0x2b>;
			pinctrl-1 = <0x2c>;
			pinctrl-2 = <0x2d>;
			pinctrl-3 = <0x2e>;
			pinctrl-4 = <0x2f>;
			pinctrl-5 = <0x30>;

			gt9886@5d {
				compatible = "goodix,gt9886";
				reg = <0x5d>;
				status = "ok";
				interrupt-parent = <0xffffffff>;
				interrupts = <0x09 0x02 0x09 0x00>;
				vtouch-supply = <0xffffffff>;
				goodix,reset-gpio = <0xffffffff 0x98 0x00>;
				goodix,irq-gpio = <0xffffffff 0x09 0x00>;
				goodix,irq-flags = <0x02>;
				goodix,panel-max-id = <0x0a>;
				goodix,panel-max-x = <0x438>;
				goodix,panel-max-y = <0x8e8>;
				goodix,panel-max-w = <0x100>;
				goodix,panel-max-p = <0x100>;
				goodix,input-max-x = <0x438>;
				goodix,input-max-y = <0x8e8>;
				goodix,panel-key-map = <0x9e 0xac 0xd9>;
				goodix,power-on-delay-us = <0x2710>;
				goodix,power-off-delay-us = <0x1388>;
				goodix,firmware-version = "6877v01";
				goodix,config-version = "6877v01";
				goodix,pen-enable;
				goodix,key-of-pen = <0x14b 0x14c>;
				tpd-filter-enable = <0x00>;
				tpd-filter-pixel-density = <0xa1>;
				tpd-filter-custom-prameters = <0x00 0x00 0x00 0x00 0x00 0x00 0x00 0x00 0x00 0x00 0x00 0x00>;
				tpd-filter-custom-speed = <0x00 0x00 0x00>;
			};
		};
	};

	fragment@16 {
		target = <0xffffffff>;

		__overlay__ {
			status = "okay";
			#address-cells = <0x01>;
			#size-cells = <0x00>;
			pinctrl-names = "default\0gt9896s_int_active\0gt9896s_reset_active\0gt9896s_int_suspend\0gt9896s_reset_suspend\0gt9896s_spi_mode";
			pinctrl-0 = <0x31>;
			pinctrl-1 = <0x32>;
			pinctrl-2 = <0x33>;
			pinctrl-3 = <0x34>;
			pinctrl-4 = <0x35>;
			pinctrl-5 = <0x36>;

			gt9896s@0 {
				compatible = "goodix,gt9896s";
				reg = <0x00>;
				spi-max-frequency = <0xf4240>;
				goodix,avdd-name = "vtouch";
				vtouch-supply = <0xffffffff>;
				goodix,reset-gpio = <0xffffffff 0x98 0x00>;
				goodix,irq-gpio = <0xffffffff 0x09 0x00>;
				goodix,irq-flags = <0x02>;
				goodix,panel-max-id = <0x0a>;
				goodix,panel-max-x = <0x438>;
				goodix,panel-max-y = <0x960>;
				goodix,panel-max-w = <0x100>;
				goodix,panel-max-p = <0x100>;
				goodix,input-max-x = <0x438>;
				goodix,input-max-y = <0x960>;
				goodix,panel-key-map = <0x9e 0xac 0xd9>;
				goodix,power-on-delay-us = <0x2710>;
				goodix,power-off-delay-us = <0x1388>;
				goodix,firmware-version = "6789v01";
				goodix,config-version = "6789v01";
				goodix,x2x;
				goodix,y2y;
				goodix,pen-enable;
				tpd-filter-enable = <0x00>;
				tpd-filter-pixel-density = <0xa1>;
				tpd-filter-custom-prameters = <0x00 0x00 0x00 0x00 0x00 0x00 0x00 0x00 0x00 0x00 0x00 0x00>;
				tpd-filter-custom-speed = <0x00 0x00 0x00>;
			};
		};
	};

	fragment@17 {
		target = <0xffffffff>;

		__overlay__ {

			eintdefault {
				phandle = <0x2b>;
			};

			pins_default {
				phandle = <0x31>;
			};

			int_active {
				phandle = <0x2c>;

				pins_cmd_dat {
					pinmux = <0x900>;
					input-enable;
				};
			};

			reset_active {
				phandle = <0x2d>;

				pins_cmd_dat {
					pinmux = <0x9800>;
					output-high;
				};
			};

			int_suspend {
				phandle = <0x2e>;

				pins_cmd_dat {
					pinmux = <0x900>;
					output-low;
				};
			};

			reset_suspend {
				phandle = <0x2f>;

				pins_cmd_dat {
					pinmux = <0x9800>;
					output-low;
				};
			};

			i2cmode_default {
				phandle = <0x30>;

				pins_cmd_dat {
					pinmux = <0x8201 0x8301>;
				};
			};

			int1_active {
				phandle = <0x32>;

				pins_cmd_dat {
					pinmux = <0x900>;
					input-enable;
				};
			};

			reset1_active {
				phandle = <0x33>;

				pins_cmd_dat {
					pinmux = <0x9800>;
					output-high;
				};
			};

			int1_suspend {
				phandle = <0x34>;

				pins_cmd_dat {
					pinmux = <0x900>;
					output-low;
				};
			};

			reset1_suspend {
				phandle = <0x35>;

				pins_cmd_dat {
					pinmux = <0x9800>;
					output-low;
				};
			};

			spimode_default {
				phandle = <0x36>;

				pins_cmd_dat {
					pinmux = <0x1e01 0x1f01 0x2001 0x2101>;
					drive-strength = <0x02>;
				};
			};
		};
	};

	fragment@18 {
		target = <0xffffffff>;

		__overlay__ {

			ft8201-i2c@38 {
				compatible = "ft8201ab,i2c";
				reg = <0x38>;
				focaltech,reset-gpio = <0xffffffff 0x98 0x00>;
				focaltech,irq-gpio = <0xffffffff 0x09 0x00>;
				focaltech,max-touch-number = <0x0a>;
				focaltech,display-coords = <0x00 0x00 0x4b0 0x7d0>;
				status = "okay";
			};

			himax@48 {
				compatible = "himax,hxcommon";
				reg = <0x48>;
				himax,panel-coords = <0x00 0x4b0 0x00 0x7d0>;
				himax,display-coords = <0x00 0x4b0 0x00 0x7d0>;
				himax,rst-gpio = <0xffffffff 0x98 0x00>;
				himax,irq-gpio = <0xffffffff 0x09 0x00>;
				report_type = <0x01>;
				status = "okay";
			};
		};
	};

	fragment@19 {
		target = <0xffffffff>;

		__overlay__ {

			lm3643@63 {
				compatible = "mediatek,lm3643";
				reg = <0x63>;
				#cooling-cells = <0x02>;
				pinctrl-names = "default\0hwen_high\0hwen_low";
				pinctrl-0 = <0x37>;
				pinctrl-1 = <0x38>;
				pinctrl-2 = <0x39>;
				status = "okay";
				phandle = <0x44>;

				flash@0 {
					reg = <0x00>;
					type = <0x00>;
					ct = <0x00>;
					part = <0x00>;

					port@0 {

						endpoint {
							remote-endpoint = <0x3a>;
							phandle = <0x3c>;
						};
					};
				};

				flash@1 {
					reg = <0x01>;
					type = <0x00>;
					ct = <0x01>;
					part = <0x00>;

					port@1 {

						endpoint {
							remote-endpoint = <0x3b>;
							phandle = <0x3d>;
						};
					};
				};
			};
		};
	};

	fragment@20 {
		target = <0xffffffff>;

		__overlay__ {

			default {
				phandle = <0x37>;
			};

			hwen_high {
				phandle = <0x38>;

				pins_cmd_dat {
					pinmux = <0x9f00>;
					slew-rate = <0x01>;
					output-high;
				};
			};

			hwen_low {
				phandle = <0x39>;

				pins_cmd_dat {
					pinmux = <0x9f00>;
					slew-rate = <0x01>;
					output-low;
				};
			};
		};
	};

	fragment@21 {
		target = <0xffffffff>;

		__overlay__ {

			port@0 {

				endpoint {
					remote-endpoint = <0x3c>;
					phandle = <0x3a>;
				};
			};

			port@1 {

				endpoint {
					remote-endpoint = <0x3d>;
					phandle = <0x3b>;
				};
			};
		};
	};

	fragment@22 {
		target = <0xffffffff>;

		__overlay__ {

			camera_main_af@72 {
				compatible = "mediatek,camera_main_af";
				reg = <0x72>;
				status = "okay";
				phandle = <0x45>;
			};
		};
	};

	fragment@23 {
		target = <0xffffffff>;

		__overlay__ {

			camera_main_two_af@0d {
				compatible = "mediatek,camera_main_two_af";
				reg = <0x0d>;
				status = "okay";
				phandle = <0x46>;
			};

			camera_main_three_af@0c {
				compatible = "mediatek,camera_main_three_af";
				reg = <0x0c>;
				status = "okay";
				phandle = <0x47>;
			};
		};
	};

	fragment@24 {
		target = <0xffffffff>;

		__overlay__ {
			camaf_m1_pmic-supply = <0xffffffff>;
			camaf_m2_pmic-supply = <0xffffffff>;
			camaf_m3_pmic-supply = <0xffffffff>;
			status = "okay";
		};
	};

	fragment@25 {
		target = <0xffffffff>;

		__overlay__ {

			speaker_amp@5c {
				compatible = "richtek,rt5512";
				#sound-dai-cells = <0x00>;
				reg = <0x5c>;
				status = "okay";
				sound-name-prefix = "Left";
				phandle = <0x3e>;
			};
		};
	};

	fragment@26 {
		target = <0xffffffff>;

		__overlay__ {
			mediatek,spk-i2s = <0x03 0x00>;

			mediatek,speaker-codec {
				sound-dai = <0x3e>;
			};
		};
	};

	fragment@27 {
		target = <0xffffffff>;

		__overlay__ {
			regulator-min-microvolt = <0x19f0a0>;
		};
	};

	fragment@28 {
		target = <0xffffffff>;

		__overlay__ {
			eint-gpio = <0xffffffff 0x08 0x00>;
			interrupt-parent = <0xffffffff>;
			interrupts = <0x08 0x00>;
			pinctrl-names = "state_eint_as_int";
			pinctrl-0 = <0x3f>;
			status = "okay";
		};
	};

	fragment@29 {
		target = <0xffffffff>;

		__overlay__ {

			hall_pins_int {
				phandle = <0x3f>;

				pins_cmd_dat {
					pinmux = <0x800>;
					slew-rate = <0x00>;
					bias-disable;
				};
			};
		};
	};

	fragment@30 {
		target = <0xffffffff>;

		__overlay__ {
			microtrust,real-drv = <0x01>;
		};
	};

	fragment@31 {
		target = <0xffffffff>;

		__overlay__ {
			regulator-boot-on;
		};
	};

	fragment@32 {
		target = <0xffffffff>;

		__overlay__ {
			GPIO_SIM1_HOT_PLUG = <0xffffffff 0x17 0x00>;
			GPIO_SIM2_HOT_PLUG = <0xffffffff 0x18 0x00>;
			GPIO_SIM1_SCLK = <0xffffffff 0x4d 0x00>;
			GPIO_SIM1_SRST = <0xffffffff 0x4e 0x00>;
			GPIO_SIM1_SIO = <0xffffffff 0x4f 0x00>;
			GPIO_SIM2_SCLK = <0xffffffff 0x50 0x00>;
			GPIO_SIM2_SRST = <0xffffffff 0x51 0x00>;
			GPIO_SIM2_SIO = <0xffffffff 0x52 0x00>;
			GPIO_FDD_BAND_SUPPORT_DETECT_1ST_PIN = <0xffffffff 0x6f 0x00>;
		};
	};

	fragment@33 {
		target = <0xffffffff>;

		__overlay__ {
			gpio_init_default = <0x00 0x00 0x00 0x00 0x01 0x01 0x01 0x01 0x00 0x00 0x00 0x01 0x00 0x01 0x02 0x00 0x00 0x00 0x01 0x00 0x01 0x03 0x00 0x00 0x00 0x01 0x00 0x01 0x04 0x00 0x00 0x00 0x01 0x01 0x01 0x05 0x00 0x00 0x00 0x01 0x01 0x01 0x06 0x00 0x00 0x00 0x01 0x01 0x01 0x07 0x00 0x00 0x00 0x01 0x01 0x01 0x08 0x00 0x00 0x00 0x01 0x00 0x01 0x09 0x00 0x00 0x00 0x01 0x01 0x01 0x0a 0x00 0x00 0x00 0x01 0x00 0x01 0x0b 0x00 0x00 0x00 0x01 0x01 0x01 0x0c 0x00 0x00 0x00 0x01 0x00 0x01 0x0d 0x06 0x00 0x00 0x01 0x00 0x01 0x0e 0x06 0x00 0x00 0x01 0x00 0x00 0x0f 0x00 0x01 0x00 0x01 0x00 0x00 0x10 0x00 0x01 0x00 0x01 0x00 0x00 0x11 0x00 0x00 0x00 0x01 0x00 0x00 0x12 0x00 0x01 0x00 0x01 0x00 0x00 0x13 0x00 0x01 0x00 0x01 0x00 0x00 0x14 0x00 0x01 0x00 0x01 0x00 0x00 0x15 0x00 0x01 0x00 0x01 0x00 0x00 0x16 0x00 0x01 0x00 0x01 0x00 0x00 0x17 0x01 0x00 0x00 0x01 0x01 0x00 0x18 0x01 0x00 0x00 0x01 0x01 0x00 0x19 0x02 0x00 0x00 0x01 0x00 0x01 0x1a 0x02 0x00 0x00 0x01 0x00 0x01 0x1b 0x01 0x00 0x00 0x01 0x00 0x01 0x1c 0x01 0x00 0x00 0x01 0x01 0x01 0x1d 0x01 0x00 0x00 0x00 0x00 0x01 0x1e 0x01 0x00 0x00 0x00 0x00 0x01 0x1f 0x01 0x00 0x00 0x00 0x00 0x01 0x20 0x01 0x00 0x00 0x00 0x00 0x01 0x21 0x01 0x00 0x00 0x01 0x00 0x01 0x22 0x06 0x00 0x00 0x01 0x00 0x00 0x23 0x06 0x00 0x00 0x01 0x00 0x00 0x24 0x06 0x00 0x00 0x00 0x00 0x00 0x25 0x06 0x00 0x00 0x01 0x00 0x00 0x26 0x02 0x00 0x00 0x00 0x00 0x01 0x27 0x02 0x00 0x00 0x00 0x00 0x01 0x28 0x02 0x00 0x00 0x00 0x00 0x01 0x29 0x02 0x00 0x00 0x01 0x00 0x01 0x2a 0x04 0x00 0x00 0x01 0x01 0x00 0x2b 0x04 0x00 0x00 0x00 0x00 0x00 0x2c 0x04 0x00 0x00 0x01 0x01 0x00 0x2d 0x04 0x00 0x00 0x00 0x00 0x00 0x2e 0x06 0x00 0x00 0x01 0x00 0x00 0x2f 0x06 0x00 0x00 0x01 0x00 0x00 0x30 0x06 0x00 0x00 0x00 0x00 0x00 0x31 0x06 0x00 0x00 0x01 0x00 0x00 0x32 0x02 0x00 0x00 0x00 0x00 0x01 0x33 0x02 0x00 0x00 0x00 0x00 0x01 0x34 0x02 0x00 0x00 0x00 0x00 0x01 0x35 0x02 0x00 0x00 0x01 0x00 0x01 0x42 0x01 0x00 0x00 0x01 0x01 0x00 0x43 0x01 0x00 0x00 0x01 0x01 0x01 0x44 0x00 0x00 0x00 0x01 0x00 0x01 0x45 0x00 0x00 0x00 0x01 0x01 0x01 0x4d 0x01 0x00 0x00 0x00 0x00 0x01 0x4e 0x01 0x00 0x00 0x00 0x00 0x01 0x4f 0x01 0x00 0x00 0x01 0x01 0x01 0x50 0x01 0x00 0x00 0x00 0x00 0x01 0x51 0x01 0x00 0x00 0x00 0x00 0x01 0x52 0x01 0x00 0x00 0x01 0x01 0x01 0x53 0x01 0x00 0x00 0x01 0x00 0x01 0x54 0x01 0x00 0x00 0x00 0x00 0x01 0x55 0x01 0x00 0x00 0x00 0x00 0x01 0x56 0x01 0x00 0x00 0x01 0x00 0x00 0x57 0x01 0x00 0x00 0x01 0x00 0x00 0x58 0x01 0x00 0x00 0x01 0x00 0x00 0x59 0x01 0x00 0x00 0x01 0x00 0x00 0x5a 0x01 0x00 0x00 0x01 0x00 0x00 0x5b 0x01 0x00 0x00 0x01 0x00 0x00 0x5c 0x01 0x00 0x00 0x01 0x00 0x00 0x5d 0x01 0x00 0x00 0x01 0x00 0x00 0x5e 0x01 0x00 0x00 0x01 0x00 0x00 0x5f 0x01 0x00 0x00 0x01 0x00 0x00 0x60 0x01 0x00 0x00 0x01 0x00 0x00 0x61 0x01 0x00 0x00 0x01 0x00 0x00 0x62 0x01 0x00 0x00 0x01 0x00 0x00 0x63 0x01 0x00 0x00 0x01 0x00 0x00 0x64 0x00 0x00 0x00 0x01 0x00 0x00 0x65 0x00 0x00 0x00 0x01 0x00 0x00 0x66 0x01 0x00 0x00 0x01 0x00 0x00 0x67 0x02 0x00 0x00 0x01 0x00 0x00 0x68 0x02 0x00 0x00 0x00 0x00 0x00 0x69 0x01 0x00 0x00 0x01 0x00 0x00 0x6a 0x01 0x00 0x00 0x01 0x00 0x00 0x6b 0x01 0x00 0x00 0x01 0x00 0x00 0x6c 0x01 0x00 0x00 0x01 0x00 0x00 0x6d 0x01 0x00 0x00 0x01 0x00 0x00 0x6e 0x01 0x00 0x00 0x01 0x00 0x00 0x6f 0x00 0x00 0x00 0x00 0x00 0x00 0x70 0x01 0x00 0x00 0x00 0x00 0x00 0x71 0x01 0x00 0x00 0x01 0x00 0x00 0x72 0x01 0x00 0x00 0x00 0x00 0x00 0x73 0x01 0x00 0x00 0x01 0x00 0x00 0x74 0x01 0x00 0x00 0x00 0x00 0x00 0x75 0x01 0x00 0x00 0x01 0x00 0x00 0x76 0x01 0x00 0x00 0x00 0x00 0x00 0x77 0x01 0x00 0x00 0x01 0x00 0x00 0x78 0x01 0x00 0x00 0x00 0x00 0x00 0x79 0x01 0x00 0x00 0x01 0x00 0x00 0x7a 0x01 0x00 0x00 0x00 0x00 0x00 0x7b 0x01 0x00 0x00 0x00 0x00 0x00 0x7c 0x01 0x00 0x00 0x01 0x00 0x00 0x7d 0x01 0x00 0x00 0x01 0x00 0x00 0x7e 0x01 0x00 0x00 0x01 0x00 0x00 0x7f 0x01 0x00 0x00 0x01 0x00 0x00 0x80 0x01 0x00 0x00 0x01 0x00 0x00 0x81 0x01 0x00 0x00 0x01 0x00 0x00 0x82 0x01 0x00 0x00 0x01 0x01 0x01 0x83 0x01 0x00 0x00 0x01 0x01 0x01 0x84 0x02 0x00 0x00 0x01 0x01 0x00 0x85 0x02 0x00 0x00 0x01 0x01 0x00 0x86 0x01 0x00 0x00 0x01 0x01 0x01 0x87 0x01 0x00 0x00 0x01 0x01 0x01 0x88 0x07 0x00 0x00 0x01 0x01 0x01 0x89 0x07 0x00 0x00 0x00 0x00 0x01 0x8a 0x01 0x00 0x00 0x01 0x01 0x01 0x8b 0x01 0x00 0x00 0x01 0x01 0x01 0x8c 0x01 0x00 0x00 0x01 0x01 0x01 0x8d 0x01 0x00 0x00 0x01 0x01 0x01 0x8e 0x01 0x00 0x00 0x01 0x01 0x01 0x8f 0x01 0x00 0x00 0x01 0x01 0x01 0x90 0x01 0x00 0x00 0x01 0x01 0x01 0x91 0x01 0x00 0x00 0x01 0x01 0x01 0x92 0x01 0x00 0x00 0x01 0x01 0x01 0x93 0x01 0x00 0x00 0x01 0x01 0x01 0x94 0x02 0x00 0x00 0x01 0x01 0x01 0x95 0x02 0x00 0x00 0x01 0x01 0x01 0x96 0x00 0x01 0x00 0x01 0x00 0x01 0x97 0x00 0x01 0x01 0x01 0x00 0x01 0x98 0x00 0x01 0x00 0x01 0x00 0x01 0x99 0x00 0x00 0x00 0x01 0x00 0x01 0x9a 0x00 0x01 0x00 0x01 0x00 0x01 0x9b 0x00 0x01 0x00 0x01 0x00 0x01 0x9c 0x00 0x01 0x00 0x01 0x00 0x01 0x9d 0x00 0x01 0x00 0x01 0x00 0x01 0x9e 0x06 0x00 0x00 0x01 0x00 0x00 0x9f 0x06 0x00 0x00 0x01 0x00 0x00 0xa0 0x01 0x00 0x00 0x00 0x00 0x01 0xa1 0x01 0x00 0x00 0x00 0x00 0x01 0xa2 0x01 0x00 0x00 0x00 0x00 0x01 0xa3 0x01 0x00 0x00 0x01 0x00 0x01 0xa4 0x01 0x00 0x00 0x00 0x00 0x01 0xa5 0x01 0x00 0x00 0x00 0x00 0x01 0xa6 0x01 0x00 0x00 0x00 0x00 0x01 0xa7 0x01 0x00 0x00 0x01 0x00 0x01 0xa8 0x01 0x00 0x00 0x00 0x00 0x00 0xa9 0x01 0x00 0x00 0x00 0x00 0x01 0xaa 0x01 0x00 0x00 0x00 0x00 0x01 0xab 0x01 0x00 0x00 0x00 0x00 0x01 0xac 0x01 0x00 0x00 0x00 0x00 0x01 0xad 0x01 0x00 0x00 0x01 0x00 0x01 0xae 0x01 0x00 0x00 0x01 0x00 0x01 0xaf 0x01 0x00 0x00 0x01 0x00 0x01 0xb0 0x01 0x00 0x00 0x01 0x00 0x01 0xb1 0x00 0x00 0x00 0x01 0x00 0x00 0xb2 0x00 0x00 0x00 0x01 0x00 0x00 0xb3 0x00 0x00 0x00 0x01 0x00 0x00 0xb4 0x00 0x00 0x00 0x01 0x00 0x00 0xb5 0x00 0x00 0x00 0x01 0x00 0x00 0xb6 0x00 0x00 0x00 0x01 0x00 0x00 0xb7 0x00 0x00 0x00 0x01 0x00 0x00 0xb8 0x00 0x00 0x00 0x01 0x00 0x00 0xb9 0x00 0x00 0x00 0x01 0x00 0x00 0xba 0x01 0x00 0x00 0x01 0x01 0x01 0xbb 0x01 0x00 0x00 0x01 0x01 0x01 0xbc 0x00 0x00 0x00 0x01 0x00 0x00 0xbd 0x00 0x00 0x00 0x01 0x00 0x00 0xbe 0x00 0x00 0x00 0x01 0x00 0x00 0xbf 0x00 0x00 0x00 0x01 0x00 0x00 0xc0 0x00 0x00 0x00 0x01 0x00 0x00 0xc1 0x00 0x00 0x00 0x01 0x00 0x00 0xc2 0x00 0x00 0x00 0x01 0x00 0x00 0xc3 0x00 0x00 0x00 0x01 0x00 0x00 0xc4 0x00 0x00 0x00 0x01 0x00 0x00 0xc5 0x00 0x00 0x00 0x01 0x00 0x00 0xc6 0x00 0x00 0x00 0x01 0x00 0x00 0xc7 0x00 0x00 0x00 0x01 0x00 0x00 0xc8 0x00 0x00 0x00 0x01 0x00 0x00 0xc9 0x00 0x00 0x00 0x01 0x00 0x00 0xca 0x00 0x00 0x00 0x01 0x00 0x00 0xcb 0x00 0x00 0x00 0x01 0x00 0x00 0xcc 0x00 0x00 0x00 0x01 0x00 0x00 0xcd 0x00 0x00 0x00 0x01 0x00 0x00 0xce 0x00 0x00 0x00 0x01 0x00 0x00 0xcf 0x00 0x00 0x00 0x01 0x00 0x00 0xd0 0x00 0x00 0x00 0x01 0x00 0x00 0xd1 0x00 0x00 0x00 0x01 0x00 0x00 0xd2 0x00 0x00 0x00 0x01 0x00 0x00 0xd3 0x00 0x00 0x00 0x01 0x00 0x00 0xd4 0x00 0x00 0x00 0x01 0x00 0x00 0xd5 0x00 0x00 0x00 0x01 0x00 0x00 0xd6 0x00 0x00 0x00 0x01 0x00 0x00 0xd7 0x00 0x00 0x00 0x01 0x00 0x00 0xd8 0x00 0x00 0x00 0x01 0x00 0x00 0xd9 0x00 0x00 0x00 0x01 0x00 0x00 0xda 0x00 0x00 0x00 0x01 0x00 0x00 0xdb 0x00 0x00 0x00 0x01 0x00 0x00 0xdc 0x00 0x00 0x00 0x01 0x00 0x00 0xdd 0x00 0x00 0x00 0x01 0x00 0x00>;
		};
	};

	fragment@34 {
		target = <0xffffffff>;

		__overlay__ {
			interrupt-parent = <0xffffffff>;
			interrupts = <0x00 0x08>;
			status = "okay";
		};
	};

	fragment@35 {
		target = <0xffffffff>;

		__overlay__ {
			interrupt-parent = <0xffffffff>;
			interrupts = <0x04 0x08>;
			status = "okay";
		};
	};

	fragment@36 {
		target = <0xffffffff>;

		__overlay__ {
			interrupt-parent = <0xffffffff>;
			interrupts = <0x05 0x02>;
			status = "okay";
		};
	};

	fragment@37 {
		target = <0xffffffff>;

		__overlay__ {
			interrupt-parent = <0xffffffff>;
			interrupts = <0x06 0x08>;
			status = "okay";
		};
	};

	fragment@38 {
		target = <0xffffffff>;

		__overlay__ {
			interrupt-parent = <0xffffffff>;
			interrupts = <0x09 0x02>;
			status = "okay";
		};
	};

	fragment@39 {
		target = <0xffffffff>;

		__overlay__ {
			interrupt-parent = <0xffffffff>;
			interrupts = <0x53 0x01>;
			status = "okay";
		};
	};

	fragment@40 {
		target = <0xffffffff>;

		__overlay__ {
			compatible = "mediatek,md1_sim1_hot_plug_eint-eint";
			interrupts = <0x00 0x04>;
			debounce = <0x00 0x2710>;
			dedicated = <0x00 0x00>;
			src_pin = <0x00 0x01>;
			sockettype = <0x00 0x00>;
			status = "okay";
		};
	};

	fragment@41 {
		target = <0xffffffff>;

		__overlay__ {
			compatible = "mediatek,md1_sim2_hot_plug_eint-eint";
			interrupts = <0x01 0x04>;
			debounce = <0x01 0x2710>;
			dedicated = <0x01 0x00>;
			src_pin = <0x01 0x02>;
			sockettype = <0x01 0x00>;
			status = "okay";
		};
	};

	fragment@42 {
		target = <0xffffffff>;

		__overlay__ {
			mediatek,key-debounce = <0x400>;
			mediatek,sw-pwrkey = <0x74>;
			mediatek,hw-pwrkey = <0x08>;
			mediatek,use-extend-type = <0x00>;
			mediatek,hw-map-num = <0x48>;
			mediatek,hw-init-map = <0x73 0x72 0x00 0x00 0x00 0x00 0x00 0x00 0x00 0x00 0x00 0x00 0x00 0x00 0x00 0x00 0x00 0x00 0x00 0x00 0x00 0x00 0x00 0x00 0x00 0x00 0x00 0x00 0x00 0x00 0x00 0x00 0x00 0x00 0x00 0x00 0x00 0x00 0x00 0x00 0x00 0x00 0x00 0x00 0x00 0x00 0x00 0x00 0x00 0x00 0x00 0x00 0x00 0x00 0x00 0x00 0x00 0x00 0x00 0x00 0x00 0x00 0x00 0x00 0x00 0x00 0x00 0x00 0x00 0x00 0x00 0x00>;
			mediatek,pwrkey-eint-gpio = <0x00>;
			mediatek,pwkey-gpio-din = <0x00>;
			mediatek,hw-dl-key0 = <0x01>;
			mediatek,hw-dl-key1 = <0x00>;
			mediatek,hw-dl-key2 = <0x08>;
			mediatek,hw-recovery-key = <0x00>;
			mediatek,hw-factory-key = <0x01>;
			status = "okay";
		};
	};

	fragment@43 {
		target = <0xffffffff>;

		__overlay__ {
			DIFFERENCE_FULLOCV_ITH = <0xc8>;
			SHUTDOWN_1_TIME = <0x05>;
			KEEP_100_PERCENT = <0x01>;
			R_FG_VALUE = <0x05>;
			EMBEDDED_SEL = <0x00>;
			PMIC_SHUTDOWN_CURRENT = <0x14>;
			FG_METER_RESISTANCE = <0x46>;
			CAR_TUNE_VALUE = <0x65>;
			PMIC_MIN_VOL = <0x82dc>;
			POWERON_SYSTEM_IBOOT = <0x1f4>;
			SHUTDOWN_GAUGE0_VOLTAGE = <0x84d0>;
			TEMPERATURE_T0 = <0x32>;
			TEMPERATURE_T1 = <0x19>;
			TEMPERATURE_T2 = <0x0a>;
			TEMPERATURE_T3 = <0x00>;
			TEMPERATURE_T4 = <0xfffffff9>;
			TEMPERATURE_T5 = <0xfffffff6>;
			g_FG_PSEUDO100_T0 = <0x64>;
			g_FG_PSEUDO100_T1 = <0x64>;
			g_FG_PSEUDO100_T2 = <0x64>;
			g_FG_PSEUDO100_T3 = <0x64>;
			g_FG_PSEUDO100_T4 = <0x64>;
			Q_MAX_SYS_VOLTAGE_BAT0 = <0xd16>;
			Q_MAX_SYS_VOLTAGE_BAT1 = <0xd16>;
			Q_MAX_SYS_VOLTAGE_BAT2 = <0xd16>;
			Q_MAX_SYS_VOLTAGE_BAT3 = <0xd16>;
			COM_FG_METER_RESISTANCE = <0x64>;
			COM_R_FG_VALUE = <0x00>;
			enable_tmp_intr_suspend = <0x00>;
			ACTIVE_TABLE = <0x06>;
			MULTI_TEMP_GAUGE0 = <0x01>;
			RBAT_PULL_UP_VOLT = <0xaf0>;
			battery0_profile_t0_num = <0x64>;
			battery0_profile_t0_col = <0x03>;
			battery0_profile_t0 = <0x00 0xa9b1 0x1e0 0x30e 0xa90b 0x1e3 0x61b 0xa874 0x1e4 0x929 0xa7e7 0x1e6 0xc36 0xa762 0x1e7 0xf44 0xa6de 0x1e8 0x1251 0xa65e 0x1ea 0x155f 0xa5e0 0x1ea 0x186c 0xa564 0x1ec 0x1b7a 0xa4ec 0x1ed 0x1e87 0xa476 0x1ef 0x2195 0xa3fe 0x1f0 0x24a2 0xa387 0x1f2 0x27b0 0xa313 0x1f4 0x2abd 0xa2a0 0x1f5 0x2dcb 0xa22d 0x1f6 0x30d9 0xa1bd 0x1f8 0x33e6 0xa14f 0x1fa 0x36f4 0xa0e0 0x1fc 0x3a01 0xa073 0x1fe 0x3d0f 0xa007 0x200 0x401c 0x9f9c 0x202 0x432a 0x9f33 0x204 0x4637 0x9ecc 0x206 0x4945 0x9e6c 0x209 0x4c52 0x9e09 0x20b 0x4f60 0x9da7 0x20f 0x526d 0x9d47 0x211 0x557b 0x9ce9 0x21a 0x5889 0x9c8d 0x21c 0x5b96 0x9c34 0x220 0x5ea4 0x9bdf 0x224 0x61b1 0x9b8c 0x228 0x64bf 0x9b39 0x22c 0x67cc 0x9ae8 0x231 0x6ada 0x9a97 0x236 0x6de7 0x9a48 0x23b 0x70f5 0x99f8 0x240 0x7402 0x99a7 0x244 0x7710 0x9951 0x244 0x7a1d 0x98f3 0x23e 0x7d2b 0x988b 0x233 0x8038 0x9815 0x220 0x8346 0x97a1 0x20d 0x8654 0x973e 0x201 0x8961 0x96eb 0x1fb 0x8c6f 0x96a5 0x1f8 0x8f7c 0x9667 0x1f6 0x928a 0x962e 0x1f6 0x9597 0x95f8 0x1f5 0x98a5 0x95c5 0x1f6 0x9bb2 0x9595 0x1f7 0x9ec0 0x956b 0x1f8 0xa1cd 0x953f 0x1fa 0xa4db 0x9516 0x1fc 0xa7e8 0x94ed 0x1fe 0xaaf6 0x94c6 0x200 0xae04 0x94a2 0x203 0xb111 0x9480 0x206 0xb41f 0x945e 0x208 0xb72c 0x943e 0x20a 0xba3a 0x9420 0x20c 0xbd47 0x9403 0x210 0xc055 0x93e7 0x212 0xc362 0x93cd 0x215 0xc670 0x93b2 0x216 0xc97d 0x9398 0x218 0xcc8b 0x937a 0x219 0xcf98 0x9354 0x214 0xd2a6 0x9317 0x206 0xd5b3 0x92cc 0x1f9 0xd8c1 0x9294 0x1fb 0xdbcf 0x926e 0x1ff 0xdedc 0x9248 0x201 0xe1ea 0x9220 0x200 0xe4f7 0x91f6 0x1ff 0xe805 0x91d0 0x1fe 0xeb12 0x91ae 0x201 0xee20 0x918e 0x205 0xf12d 0x9168 0x208 0xf43b 0x9135 0x207 0xf748 0x90f5 0x204 0xfa56 0x90b6 0x204 0xfd63 0x907b 0x207 0x10071 0x9033 0x207 0x1037f 0x8fe6 0x1fe 0x1068c 0x8fbc 0x1fb 0x1099a 0x8fb0 0x202 0x10ca7 0x8fa8 0x20c 0x10fb5 0x8f9e 0x217 0x112c2 0x8f8d 0x224 0x115d0 0x8f6c 0x23a 0x118dd 0x8ed6 0x234 0x11beb 0x8d65 0x227 0x11ef8 0x8b60 0x232 0x12206 0x88ac 0x249 0x12513 0x84ad 0x280 0x12821 0x7d83 0x393 0x12b2e 0x79a9 0x300 0x12e3c 0x79a9 0x300>;
			battery0_profile_t1_num = <0x64>;
			battery0_profile_t1_col = <0x03>;
			battery0_profile_t1 = <0x00 0xa99f 0x2b2 0x30e 0xa8e7 0x2ae 0x61b 0xa845 0x2af 0x929 0xa7ac 0x2ae 0xc36 0xa71d 0x2ab 0xf44 0xa697 0x2a7 0x1251 0xa615 0x2a8 0x155f 0xa59b 0x2a8 0x186c 0xa521 0x2a8 0x1b7a 0xa4aa 0x2a9 0x1e87 0xa436 0x2ae 0x2195 0xa3c3 0x2b1 0x24a2 0xa352 0x2b0 0x27b0 0xa2e4 0x2af 0x2abd 0xa277 0x2af 0x2dcb 0xa209 0x2ae 0x30d9 0xa19c 0x2af 0x33e6 0xa12f 0x2ad 0x36f4 0xa0c3 0x2ad 0x3a01 0xa057 0x2b3 0x3d0f 0x9fee 0x2ba 0x401c 0x9f8d 0x2be 0x432a 0x9f3a 0x2c2 0x4637 0x9f07 0x2d3 0x4945 0x9ed0 0x2e7 0x4c52 0x9e55 0x2da 0x4f60 0x9da7 0x2d0 0x526d 0x9cfb 0x2cc 0x557b 0x9c6f 0x2cc 0x5889 0x9c03 0x2d1 0x5b96 0x9bb6 0x2d9 0x5ea4 0x9b87 0x2e5 0x61b1 0x9b61 0x2ea 0x64bf 0x9b2a 0x2ea 0x67cc 0x9ae8 0x2f0 0x6ada 0x9a9c 0x2f5 0x6de7 0x9a4c 0x2f7 0x70f5 0x99f8 0x2f7 0x7402 0x999f 0x2f3 0x7710 0x993f 0x2ec 0x7a1d 0x98da 0x2df 0x7d2b 0x9876 0x2cf 0x8038 0x9817 0x2c0 0x8346 0x97bd 0x2b5 0x8654 0x9767 0x2a9 0x8961 0x9717 0x2a0 0x8c6f 0x96cd 0x296 0x8f7c 0x968c 0x292 0x928a 0x964d 0x28e 0x9597 0x9615 0x28f 0x98a5 0x95e0 0x28f 0x9bb2 0x95b1 0x290 0x9ec0 0x9584 0x292 0xa1cd 0x9559 0x297 0xa4db 0x9531 0x29b 0xa7e8 0x950a 0x29c 0xaaf6 0x94e5 0x29a 0xae04 0x94c3 0x29a 0xb111 0x94a2 0x29b 0xb41f 0x9483 0x29d 0xb72c 0x9465 0x29d 0xba3a 0x9448 0x29d 0xbd47 0x942c 0x29f 0xc055 0x9411 0x2a2 0xc362 0x93f8 0x2a5 0xc670 0x93e0 0x2a6 0xc97d 0x93c7 0x2a5 0xcc8b 0x93b0 0x2a6 0xcf98 0x9397 0x2a9 0xd2a6 0x9381 0x2ac 0xd5b3 0x9369 0x2aa 0xd8c1 0x9350 0x2a9 0xdbcf 0x9336 0x2a9 0xdedc 0x9319 0x2ac 0xe1ea 0x92f5 0x2ac 0xe4f7 0x92cd 0x2a8 0xe805 0x92a6 0x2a6 0xeb12 0x9285 0x2a8 0xee20 0x9266 0x2b0 0xf12d 0x9244 0x2b7 0xf43b 0x9217 0x2bb 0xf748 0x91dd 0x2bb 0xfa56 0x919e 0x2bd 0xfd63 0x9163 0x2c3 0x10071 0x9127 0x2c9 0x1037f 0x90da 0x2c9 0x1068c 0x908e 0x2c7 0x1099a 0x9065 0x2cd 0x10ca7 0x9054 0x2d7 0x10fb5 0x9049 0x2e4 0x112c2 0x903e 0x2f5 0x115d0 0x902e 0x30f 0x118dd 0x900c 0x331 0x11beb 0x8f92 0x34b 0x11ef8 0x8e27 0x341 0x12206 0x8c14 0x35f 0x12513 0x893d 0x396 0x12821 0x84e4 0x418 0x12b2e 0x7cf8 0x534 0x12e3c 0x7b01 0x3e1>;
			battery0_profile_t2_num = <0x64>;
			battery0_profile_t2_col = <0x03>;
			battery0_profile_t2 = <0x00 0xa99f 0x2b2 0x30e 0xa8e7 0x2ae 0x61b 0xa845 0x2af 0x929 0xa7ac 0x2ae 0xc36 0xa71d 0x2ab 0xf44 0xa697 0x2a7 0x1251 0xa615 0x2a8 0x155f 0xa59b 0x2a8 0x186c 0xa521 0x2a8 0x1b7a 0xa4aa 0x2a9 0x1e87 0xa436 0x2ae 0x2195 0xa3c3 0x2b1 0x24a2 0xa352 0x2b0 0x27b0 0xa2e4 0x2af 0x2abd 0xa277 0x2af 0x2dcb 0xa209 0x2ae 0x30d9 0xa19c 0x2af 0x33e6 0xa12f 0x2ad 0x36f4 0xa0c3 0x2ad 0x3a01 0xa057 0x2b3 0x3d0f 0x9fee 0x2ba 0x401c 0x9f8d 0x2be 0x432a 0x9f3a 0x2c2 0x4637 0x9f07 0x2d3 0x4945 0x9ed0 0x2e7 0x4c52 0x9e55 0x2da 0x4f60 0x9da7 0x2d0 0x526d 0x9cfb 0x2cc 0x557b 0x9c6f 0x2cc 0x5889 0x9c03 0x2d1 0x5b96 0x9bb6 0x2d9 0x5ea4 0x9b87 0x2e5 0x61b1 0x9b61 0x2ea 0x64bf 0x9b2a 0x2ea 0x67cc 0x9ae8 0x2f0 0x6ada 0x9a9c 0x2f5 0x6de7 0x9a4c 0x2f7 0x70f5 0x99f8 0x2f7 0x7402 0x999f 0x2f3 0x7710 0x993f 0x2ec 0x7a1d 0x98da 0x2df 0x7d2b 0x9876 0x2cf 0x8038 0x9817 0x2c0 0x8346 0x97bd 0x2b5 0x8654 0x9767 0x2a9 0x8961 0x9717 0x2a0 0x8c6f 0x96cd 0x296 0x8f7c 0x968c 0x292 0x928a 0x964d 0x28e 0x9597 0x9615 0x28f 0x98a5 0x95e0 0x28f 0x9bb2 0x95b1 0x290 0x9ec0 0x9584 0x292 0xa1cd 0x9559 0x297 0xa4db 0x9531 0x29b 0xa7e8 0x950a 0x29c 0xaaf6 0x94e5 0x29a 0xae04 0x94c3 0x29a 0xb111 0x94a2 0x29b 0xb41f 0x9483 0x29d 0xb72c 0x9465 0x29d 0xba3a 0x9448 0x29d 0xbd47 0x942c 0x29f 0xc055 0x9411 0x2a2 0xc362 0x93f8 0x2a5 0xc670 0x93e0 0x2a6 0xc97d 0x93c7 0x2a5 0xcc8b 0x93b0 0x2a6 0xcf98 0x9397 0x2a9 0xd2a6 0x9381 0x2ac 0xd5b3 0x9369 0x2aa 0xd8c1 0x9350 0x2a9 0xdbcf 0x9336 0x2a9 0xdedc 0x9319 0x2ac 0xe1ea 0x92f5 0x2ac 0xe4f7 0x92cd 0x2a8 0xe805 0x92a6 0x2a6 0xeb12 0x9285 0x2a8 0xee20 0x9266 0x2b0 0xf12d 0x9244 0x2b7 0xf43b 0x9217 0x2bb 0xf748 0x91dd 0x2bb 0xfa56 0x919e 0x2bd 0xfd63 0x9163 0x2c3 0x10071 0x9127 0x2c9 0x1037f 0x90da 0x2c9 0x1068c 0x908e 0x2c7 0x1099a 0x9065 0x2cd 0x10ca7 0x9054 0x2d7 0x10fb5 0x9049 0x2e4 0x112c2 0x903e 0x2f5 0x115d0 0x902e 0x30f 0x118dd 0x900c 0x331 0x11beb 0x8f92 0x34b 0x11ef8 0x8e27 0x341 0x12206 0x8c14 0x35f 0x12513 0x893d 0x396 0x12821 0x84e4 0x418 0x12b2e 0x7cf8 0x534 0x12e3c 0x7b01 0x3e1>;
			battery0_profile_t3_num = <0x64>;
			battery0_profile_t3_col = <0x03>;
			battery0_profile_t3 = <0x00 0xa93c 0x5be 0x30e 0xa84b 0x68d 0x61b 0xa7a4 0x69f 0x929 0xa716 0x6a9 0xc36 0xa694 0x6ac 0xf44 0xa617 0x6aa 0x1251 0xa59d 0x6af 0x155f 0xa526 0x6b1 0x186c 0xa4b3 0x6b5 0x1b7a 0xa444 0x6bb 0x1e87 0xa3d6 0x6bb 0x2195 0xa369 0x6b6 0x24a2 0xa2fe 0x6ba 0x27b0 0xa291 0x6ba 0x2abd 0xa226 0x6ab 0x2dcb 0xa1bb 0x6b6 0x30d9 0xa150 0x6c7 0x33e6 0xa0e5 0x6cc 0x36f4 0xa07e 0x6cf 0x3a01 0xa01d 0x6d4 0x3d0f 0x9fcf 0x6da 0x401c 0x9f98 0x6ee 0x432a 0x9f68 0x709 0x4637 0x9f14 0x716 0x4945 0x9e77 0x711 0x4c52 0x9d97 0x6eb 0x4f60 0x9cc6 0x6d2 0x526d 0x9c28 0x6c8 0x557b 0x9bb1 0x6cd 0x5889 0x9b56 0x6d3 0x5b96 0x9b09 0x6d0 0x5ea4 0x9ac7 0x6cf 0x61b1 0x9a90 0x6d8 0x64bf 0x9a5e 0x6e7 0x67cc 0x9a26 0x6eb 0x6ada 0x99e0 0x6db 0x6de7 0x998a 0x6c6 0x70f5 0x992b 0x6b2 0x7402 0x98cb 0x6a2 0x7710 0x986e 0x690 0x7a1d 0x9815 0x653 0x7d2b 0x97bf 0x657 0x8038 0x976d 0x663 0x8346 0x9723 0x668 0x8654 0x96dd 0x669 0x8961 0x969e 0x666 0x8c6f 0x9663 0x669 0x8f7c 0x962a 0x675 0x928a 0x95f7 0x673 0x9597 0x95c6 0x670 0x98a5 0x9599 0x676 0x9bb2 0x9570 0x680 0x9ec0 0x9547 0x689 0xa1cd 0x9520 0x68b 0xa4db 0x94fa 0x692 0xa7e8 0x94d6 0x69b 0xaaf6 0x94b4 0x6a4 0xae04 0x9494 0x6ac 0xb111 0x9475 0x6b4 0xb41f 0x9457 0x6c2 0xb72c 0x943a 0x6cd 0xba3a 0x9420 0x6cf 0xbd47 0x9407 0x6d5 0xc055 0x93f1 0x6d9 0xc362 0x93df 0x6e0 0xc670 0x93ce 0x6f0 0xc97d 0x93be 0x6ff 0xcc8b 0x93b0 0x705 0xcf98 0x939f 0x718 0xd2a6 0x9390 0x721 0xd5b3 0x937d 0x72e 0xd8c1 0x936a 0x73e 0xdbcf 0x9354 0x74c 0xdedc 0x933d 0x75b 0xe1ea 0x9322 0x773 0xe4f7 0x9305 0x78c 0xe805 0x92e3 0x7a7 0xeb12 0x92bd 0x7b4 0xee20 0x9292 0x7c4 0xf12d 0x9261 0x7db 0xf43b 0x922b 0x7ef 0xf748 0x91f2 0x807 0xfa56 0x91b6 0x828 0xfd63 0x9172 0x850 0x10071 0x9129 0x886 0x1037f 0x90ec 0x8c3 0x1068c 0x90c3 0x8ff 0x1099a 0x90a8 0x941 0x10ca7 0x9093 0x997 0x10fb5 0x907b 0xa0a 0x112c2 0x9059 0xa82 0x115d0 0x9016 0xb05 0x118dd 0x8f7a 0xb95 0x11beb 0x8e23 0xc2b 0x11ef8 0x8c0a 0xcfa 0x12206 0x891a 0xd4c 0x12513 0x850f 0xa9b 0x12821 0x8196 0x849 0x12b2e 0x8196 0x849 0x12e3c 0x8196 0x849>;
			battery0_profile_t4_num = <0x64>;
			battery0_profile_t4_col = <0x03>;
			battery0_profile_t4 = <0x00 0xa8dc 0x5be 0x30e 0xa793 0xbc0 0x61b 0xa684 0xcb3 0x929 0xa5c7 0xd44 0xc36 0xa534 0xd60 0xf44 0xa4b2 0xd6b 0x1251 0xa439 0xd6a 0x155f 0xa3c6 0xd6a 0x186c 0xa356 0xd62 0x1b7a 0xa2e8 0xd61 0x1e87 0xa27b 0xd60 0x2195 0xa20d 0xd5b 0x24a2 0xa1a0 0xd52 0x27b0 0xa133 0xd3c 0x2abd 0xa0c9 0xd2c 0x2dcb 0xa06b 0xd33 0x30d9 0xa01d 0xcfc 0x33e6 0x9fdb 0xd1c 0x36f4 0x9f95 0xd23 0x3a01 0x9f39 0xd38 0x3d0f 0x9eb2 0xd40 0x401c 0x9df6 0xd2c 0x432a 0x9d25 0xce0 0x4637 0x9c6f 0xcd0 0x4945 0x9bda 0xcc1 0x4c52 0x9b65 0xcb2 0x4f60 0x9b04 0xcaf 0x526d 0x9ab4 0xcb5 0x557b 0x9a6c 0xca4 0x5889 0x9a2c 0xcb2 0x5b96 0x99ee 0xcb6 0x5ea4 0x99ac 0xcbd 0x61b1 0x9964 0xca7 0x64bf 0x9914 0xc9e 0x67cc 0x98be 0xc92 0x6ada 0x9864 0xc80 0x6de7 0x980b 0xc72 0x70f5 0x97b6 0xc64 0x7402 0x9765 0xc63 0x7710 0x971a 0xc65 0x7a1d 0x96d4 0xc50 0x7d2b 0x9695 0xc47 0x8038 0x965a 0xc47 0x8346 0x9622 0xc50 0x8654 0x95ee 0xc59 0x8961 0x95bc 0xc60 0x8c6f 0x958f 0xc57 0x8f7c 0x9561 0xc85 0x928a 0x9536 0xc73 0x9597 0x950e 0xc8d 0x98a5 0x94e8 0xc94 0x9bb2 0x94c3 0xca5 0x9ec0 0x949f 0xca1 0xa1cd 0x947e 0xcac 0xa4db 0x9462 0xcbb 0xa7e8 0x9448 0xcc3 0xaaf6 0x9432 0xcb8 0xae04 0x941e 0xcb3 0xb111 0x9409 0xd19 0xb41f 0x93f8 0xd0f 0xb72c 0x93e6 0xd1c 0xba3a 0x93d5 0xd35 0xbd47 0x93c3 0xd45 0xc055 0x93b1 0xd69 0xc362 0x939e 0xd84 0xc670 0x938b 0xd9d 0xc97d 0x9377 0xda9 0xcc8b 0x9360 0xdd3 0xcf98 0x9346 0xe0d 0xd2a6 0x9328 0xe33 0xd5b3 0x930a 0xe4f 0xd8c1 0x92e8 0xe8d 0xdbcf 0x92c4 0xeb4 0xdedc 0x929b 0xed6 0xe1ea 0x926f 0xf0c 0xe4f7 0x9240 0xf44 0xe805 0x920c 0xf7d 0xeb12 0x91d5 0xfb3 0xee20 0x919e 0x1001 0xf12d 0x9168 0x1048 0xf43b 0x9135 0x1095 0xf748 0x9109 0x10df 0xfa56 0x90e1 0x1141 0xfd63 0x90be 0x11bb 0x10071 0x9098 0x1220 0x1037f 0x906e 0x122a 0x1068c 0x9034 0x1203 0x1099a 0x8fd9 0x11c9 0x10ca7 0x8f3f 0x1165 0x10fb5 0x8e21 0x10a4 0x112c2 0x8c61 0xf7b 0x115d0 0x89fa 0xde0 0x118dd 0x8752 0xc1c 0x11beb 0x858d 0xaef 0x11ef8 0x84b5 0xa5c 0x12206 0x84b5 0xa5c 0x12513 0x84b5 0xa5c 0x12821 0x84b5 0xa5c 0x12b2e 0x84b5 0xa5c 0x12e3c 0x84b5 0xa5c>;
			g_PMIC_MIN_VOL_row = <0x04>;
			g_PMIC_MIN_VOL_col = <0x0a>;
			g_PMIC_MIN_VOL = <0x82dc 0x82dc 0x82dc 0x82dc 0x80e8 0x80e8 0x80e8 0x80e8 0x80e8 0x80e8 0x80e8 0x80e8 0x7dc8 0x7dc8 0x7dc8 0x7dc8 0x7918 0x7918 0x7918 0x7918 0x7b0c 0x7b0c 0x7b0c 0x7b0c 0x7918 0x7918 0x7918 0x7918 0x7918 0x7918 0x7918 0x7918 0x7918 0x7918 0x7918 0x7918 0x7918 0x7918 0x7918 0x79e0>;
			g_PON_SYS_IBOOT_row = <0x04>;
			g_PON_SYS_IBOOT_col = <0x0a>;
			g_PON_SYS_IBOOT = <0x1388 0x1388 0x1388 0x1388 0x1388 0x1388 0x1388 0x1388 0x1388 0x1388 0x1388 0x1388 0x1388 0x1388 0x1388 0x1388 0x1388 0x1388 0x1388 0x1388 0x1388 0x1388 0x1388 0x1388 0x1388 0x1388 0x1388 0x1388 0x1388 0x1388 0x1388 0x1388 0x1388 0x1388 0x1388 0x1388 0x1388 0x1388 0x1388 0x1388>;
			g_QMAX_SYS_VOL_row = <0x04>;
			g_QMAX_SYS_VOL_col = <0x0a>;
			g_QMAX_SYS_VOL = <0x8886 0x8886 0x8886 0x8886 0x8886 0x8886 0x8886 0x8886 0x85ca 0x85ca 0x85ca 0x85ca 0x85ca 0x85ca 0x85ca 0x85ca 0x85ca 0x85ca 0x85ca 0x85ca 0x7ef4 0x7ef4 0x7ef4 0x7ef4 0x8020 0x8020 0x8020 0x8020 0x8020 0x8020 0x8020 0x8020 0x8020 0x8020 0x8020 0x8020 0x8020 0x8020 0x8020 0x8020>;
			g_FG_PSEUDO100_row = <0x04>;
			g_FG_PSEUDO100_col = <0x0a>;
			g_FG_PSEUDO100 = <0x64 0x64 0x64 0x64 0x64 0x64 0x64 0x64 0x64 0x64 0x64 0x64 0x64 0x64 0x64 0x64 0x64 0x64 0x64 0x64 0x64 0x64 0x64 0x64 0x64 0x64 0x64 0x64 0x64 0x64 0x64 0x64 0x64 0x64 0x64 0x64 0x64 0x64 0x64 0x64>;
			g_FG_charge_PSEUDO100_row = <0x04>;
			g_FG_charge_PSEUDO100_col = <0x0a>;
			g_FG_charge_PSEUDO100 = <0x64 0x64 0x64 0x64 0x64 0x64 0x64 0x64 0x64 0x64 0x64 0x64 0x64 0x64 0x64 0x64 0x64 0x64 0x64 0x64 0x64 0x64 0x64 0x64 0x64 0x64 0x64 0x64 0x64 0x64 0x64 0x64 0x64 0x64 0x64 0x64 0x64 0x64 0x64 0x64>;
		};
	};

	__symbols__ {
		camera_pins_cam0_rst_0 = "/fragment@0/__overlay__/cam0@0";
		camera_pins_cam0_rst_1 = "/fragment@0/__overlay__/cam0@1";
		camera_pins_cam0_pnd0 = "/fragment@0/__overlay__/cam0@2";
		camera_pins_cam0_pnd1 = "/fragment@0/__overlay__/cam0@3";
		camera_pins_cam_ldo_rear_vcama_0 = "/fragment@0/__overlay__/cam0@vcama0";
		camera_pins_cam_ldo_rear_vcama_1 = "/fragment@0/__overlay__/cam0@vcamd1";
		camera_pins_cam_ldo_rear_vcamaf_0 = "/fragment@0/__overlay__/cam0@vcamaf0";
		camera_pins_cam_ldo_rear_vcamaf_1 = "/fragment@0/__overlay__/cam0@vcamaf1";
		camera_pins_cam1_rst_0 = "/fragment@0/__overlay__/cam1@0";
		camera_pins_cam1_rst_1 = "/fragment@0/__overlay__/cam1@1";
		camera_pins_cam1_pnd0 = "/fragment@0/__overlay__/cam1@2";
		camera_pins_cam1_pnd1 = "/fragment@0/__overlay__/cam1@3";
		camera_pins_cam_ldo_sub_vcama_0 = "/fragment@0/__overlay__/cam1@vcama0";
		camera_pins_cam_ldo_sub_vcama_1 = "/fragment@0/__overlay__/cam1@vcama1";
		camera_pins_cam0_mclk_off = "/fragment@0/__overlay__/camera_pins_cam0_mclk_off";
		camera_pins_cam0_mclk_2ma = "/fragment@0/__overlay__/camera_pins_cam0_mclk_2ma";
		camera_pins_cam0_mclk_4ma = "/fragment@0/__overlay__/camera_pins_cam0_mclk_4ma";
		camera_pins_cam0_mclk_6ma = "/fragment@0/__overlay__/camera_pins_cam0_mclk_6ma";
		camera_pins_cam0_mclk_8ma = "/fragment@0/__overlay__/camera_pins_cam0_mclk_8ma";
		camera_pins_cam1_mclk_off = "/fragment@0/__overlay__/camera_pins_cam1_mclk_off";
		camera_pins_cam1_mclk_2ma = "/fragment@0/__overlay__/camera_pins_cam1_mclk_2ma";
		camera_pins_cam1_mclk_4ma = "/fragment@0/__overlay__/camera_pins_cam1_mclk_4ma";
		camera_pins_cam1_mclk_6ma = "/fragment@0/__overlay__/camera_pins_cam1_mclk_6ma";
		camera_pins_cam1_mclk_8ma = "/fragment@0/__overlay__/camera_pins_cam1_mclk_8ma";
		camera_pins_default = "/fragment@0/__overlay__/camdefault";
		camera_sub_mtk = "/fragment@2/__overlay__/camera_sub@1a";
		camera_main_mtk = "/fragment@3/__overlay__/camera_main@1a";
		camera_main_af = "/fragment@3/__overlay__/camera_main_af@51";
		camera_main = "/fragment@4/__overlay__/camera_main";
		camera_sub = "/fragment@4/__overlay__/camera_sub";
		mtkfb_pins_lcm_led_en1 = "/fragment@8/__overlay__/lcm_led_en1_gpio";
		mtkfb_pins_lcm_led_en0 = "/fragment@8/__overlay__/lcm_led_en0_gpio";
		mtkfb_pins_lcm_rst_out1_gpio = "/fragment@8/__overlay__/lcm_rst_out1_gpio";
		mtkfb_pins_lcm_rst_out0_gpio = "/fragment@8/__overlay__/lcm_rst_out0_gpio";
		mtkfb_pins_lcm_dsi_te = "/fragment@8/__overlay__/lcm_dsi_te";
		lp62701_gateic = "/fragment@11/__overlay__/lp62701@3e";
		panel_in1 = "/fragment@12/__overlay__/panel1@0/port/endpoint";
		panel_in2 = "/fragment@12/__overlay__/panel2@1/port/endpoint";
		dsi_out = "/fragment@12/__overlay__/ports/port/endpoint";
		gps_pins_default = "/fragment@13/__overlay__/gps_default";
		gps_l1_lna_pins_ol = "/fragment@13/__overlay__/gps_l1_lna@0";
		gps_l1_lna_pins_dsp_ctrl = "/fragment@13/__overlay__/gps_l1_lna@1";
		gps_l1_lna_pins_oh = "/fragment@13/__overlay__/gps_l1_lna@2";
		gps_l5_lna_pins_ol = "/fragment@13/__overlay__/gps_l5_lna@0";
		gps_l5_lna_pins_dsp_ctrl = "/fragment@13/__overlay__/gps_l5_lna@1";
		gps_l5_lna_pins_oh = "/fragment@13/__overlay__/gps_l5_lna@2";
		ctp_pins_default = "/fragment@17/__overlay__/eintdefault";
		ctp_gt9896s_pins_default = "/fragment@17/__overlay__/pins_default";
		ctp_ts_int_active = "/fragment@17/__overlay__/int_active";
		ctp_ts_reset_active = "/fragment@17/__overlay__/reset_active";
		ctp_ts_int_suspend = "/fragment@17/__overlay__/int_suspend";
		ctp_ts_reset_suspend = "/fragment@17/__overlay__/reset_suspend";
		ctp_ts_i2c_mode = "/fragment@17/__overlay__/i2cmode_default";
		ctp_gt9896s_int_active = "/fragment@17/__overlay__/int1_active";
		ctp_gt9896s_reset_active = "/fragment@17/__overlay__/reset1_active";
		ctp_gt9896s_int_suspend = "/fragment@17/__overlay__/int1_suspend";
		ctp_gt9896s_reset_suspend = "/fragment@17/__overlay__/reset1_suspend";
		ctp_gt9896s_spi_mode = "/fragment@17/__overlay__/spimode_default";
		lm3643 = "/fragment@19/__overlay__/lm3643@63";
		fl_core_0 = "/fragment@19/__overlay__/lm3643@63/flash@0/port@0/endpoint";
		fl_core_1 = "/fragment@19/__overlay__/lm3643@63/flash@1/port@1/endpoint";
		lm3643_pins_default = "/fragment@20/__overlay__/default";
		lm3643_pins_hwen_high = "/fragment@20/__overlay__/hwen_high";
		lm3643_pins_hwen_low = "/fragment@20/__overlay__/hwen_low";
		flashlight_0 = "/fragment@21/__overlay__/port@0/endpoint";
		flashlight_1 = "/fragment@21/__overlay__/port@1/endpoint";
		camera_main_af_mtk = "/fragment@22/__overlay__/camera_main_af@72";
		camera_main_two_af_mtk = "/fragment@23/__overlay__/camera_main_two_af@0d";
		camera_main_three_af_mtk = "/fragment@23/__overlay__/camera_main_three_af@0c";
		spk = "/fragment@25/__overlay__/speaker_amp@5c";
		hall_pins_int = "/fragment@29/__overlay__/hall_pins_int";
	};

	__fixups__ {
		pio = "/fragment@0:target:0\0/fragment@8:target:0\0/fragment@12/__overlay__/panel1@0:reset-gpios:0\0/fragment@12/__overlay__/panel1@0:biasen-gpios:0\0/fragment@12/__overlay__/panel1@0:bl-gpios:0\0/fragment@12/__overlay__/panel2@1:reset-gpios:0\0/fragment@12/__overlay__/panel2@1:biasen-gpios:0\0/fragment@12/__overlay__/panel2@1:bl-gpios:0\0/fragment@13:target:0\0/fragment@15/__overlay__/gt9886@5d:interrupt-parent:0\0/fragment@15/__overlay__/gt9886@5d:goodix,reset-gpio:0\0/fragment@15/__overlay__/gt9886@5d:goodix,irq-gpio:0\0/fragment@16/__overlay__/gt9896s@0:goodix,reset-gpio:0\0/fragment@16/__overlay__/gt9896s@0:goodix,irq-gpio:0\0/fragment@17:target:0\0/fragment@18/__overlay__/ft8201-i2c@38:focaltech,reset-gpio:0\0/fragment@18/__overlay__/ft8201-i2c@38:focaltech,irq-gpio:0\0/fragment@18/__overlay__/himax@48:himax,rst-gpio:0\0/fragment@18/__overlay__/himax@48:himax,irq-gpio:0\0/fragment@20:target:0\0/fragment@28/__overlay__:eint-gpio:0\0/fragment@28/__overlay__:interrupt-parent:0\0/fragment@29:target:0\0/fragment@32/__overlay__:GPIO_SIM1_HOT_PLUG:0\0/fragment@32/__overlay__:GPIO_SIM2_HOT_PLUG:0\0/fragment@32/__overlay__:GPIO_SIM1_SCLK:0\0/fragment@32/__overlay__:GPIO_SIM1_SRST:0\0/fragment@32/__overlay__:GPIO_SIM1_SIO:0\0/fragment@32/__overlay__:GPIO_SIM2_SCLK:0\0/fragment@32/__overlay__:GPIO_SIM2_SRST:0\0/fragment@32/__overlay__:GPIO_SIM2_SIO:0\0/fragment@32/__overlay__:GPIO_FDD_BAND_SUPPORT_DETECT_1ST_PIN:0\0/fragment@34/__overlay__:interrupt-parent:0\0/fragment@35/__overlay__:interrupt-parent:0\0/fragment@36/__overlay__:interrupt-parent:0\0/fragment@37/__overlay__:interrupt-parent:0\0/fragment@38/__overlay__:interrupt-parent:0\0/fragment@39/__overlay__:interrupt-parent:0";
		kd_camera_hw1 = "/fragment@1:target:0";
		mt6358_vrf18_reg = "/fragment@1/__overlay__:cam0_vcamio-supply:0\0/fragment@1/__overlay__:cam1_vcamio-supply:0";
		mt6358_vrf12_reg = "/fragment@1/__overlay__:cam0_vcamd-supply:0\0/fragment@1/__overlay__:cam1_vcamd-supply:0";
		i2c4 = "/fragment@2:target:0";
		i2c8 = "/fragment@3:target:0\0/fragment@22:target:0";
		thermal_zones = "/fragment@4:target:0";
		chosen = "/fragment@5:target:0";
		android = "/fragment@6:target:0";
		mtk_leds = "/fragment@7:target:0";
		disp_pwm = "/fragment@7/__overlay__/backlight:pwms:0";
		mtkfb = "/fragment@9:target:0";
		dispsys_config = "/fragment@10:target:0";
		i2c6 = "/fragment@11:target:0\0/fragment@18:target:0\0/fragment@19:target:0\0/fragment@25:target:0";
		dsi0 = "/fragment@12:target:0";
		mt6358_vsim1_reg = "/fragment@12/__overlay__/panel1@0:iovcc-supply:0\0/fragment@12/__overlay__/panel2@1:iovcc-supply:0\0/fragment@27:target:0";
		gps = "/fragment@14:target:0";
		i2c0 = "/fragment@15:target:0";
		mt6358_vio28_reg = "/fragment@15/__overlay__/gt9886@5d:vtouch-supply:0\0/fragment@16/__overlay__/gt9896s@0:vtouch-supply:0";
		spi0 = "/fragment@16:target:0";
		mtk_composite_v4l2_1 = "/fragment@21:target:0";
		i2c2 = "/fragment@23:target:0";
		camera_af_hw_node = "/fragment@24:target:0";
		rt5133_ldo3 = "/fragment@24/__overlay__:camaf_m1_pmic-supply:0";
		rt5133_gpio1 = "/fragment@24/__overlay__:camaf_m2_pmic-supply:0\0/fragment@24/__overlay__:camaf_m3_pmic-supply:0";
		sound = "/fragment@26:target:0";
		hall = "/fragment@28:target:0";
		utos = "/fragment@30:target:0";
		mt6358_vmch_eint_high = "/fragment@31:target:0";
		gpio_usage_mapping = "/fragment@32:target:0";
		gpio = "/fragment@33:target:0";
		mrdump_ext_rst = "/fragment@34:target:0";
		subpmic_pmu_eint = "/fragment@35:target:0";
		rt5133_eint = "/fragment@36:target:0";
		smart_pa = "/fragment@37:target:0";
		touch = "/fragment@38:target:0";
		dsi_te = "/fragment@39:target:0";
		md1_sim1_hot_plug_eint = "/fragment@40:target:0";
		md1_sim2_hot_plug_eint = "/fragment@41:target:0";
		keypad = "/fragment@42:target:0";
		mtk_gauge = "/fragment@43:target:0";
	};

	__local_fixups__ {

		fragment@1 {

			__overlay__ {
				pinctrl-0 = <0x00>;
				pinctrl-1 = <0x00>;
				pinctrl-2 = <0x00>;
				pinctrl-3 = <0x00>;
				pinctrl-4 = <0x00>;
				pinctrl-5 = <0x00>;
				pinctrl-6 = <0x00>;
				pinctrl-7 = <0x00>;
				pinctrl-8 = <0x00>;
				pinctrl-9 = <0x00>;
				pinctrl-10 = <0x00>;
				pinctrl-11 = <0x00>;
				pinctrl-12 = <0x00>;
				pinctrl-13 = <0x00>;
				pinctrl-14 = <0x00>;
				pinctrl-15 = <0x00>;
				pinctrl-16 = <0x00>;
				pinctrl-17 = <0x00>;
				pinctrl-18 = <0x00>;
				pinctrl-19 = <0x00>;
				pinctrl-20 = <0x00>;
				pinctrl-21 = <0x00>;
				pinctrl-22 = <0x00>;
				pinctrl-23 = <0x00>;
				pinctrl-24 = <0x00>;
			};
		};

		fragment@4 {

			__overlay__ {

				camera_main {
					thermal-sensors = <0x00>;
				};

				camera_sub {
					thermal-sensors = <0x00>;
				};
			};
		};

		fragment@9 {

			__overlay__ {
				pinctrl-0 = <0x00>;
				pinctrl-1 = <0x00>;
				pinctrl-2 = <0x00>;
				pinctrl-3 = <0x00>;
				pinctrl-4 = <0x00>;
			};
		};

		fragment@10 {

			__overlay__ {
				pinctrl-0 = <0x00>;
				pinctrl-1 = <0x00>;
				pinctrl-2 = <0x00>;
			};
		};

		fragment@12 {

			__overlay__ {

				panel1@0 {
					gate-ic = <0x00>;

					port {

						endpoint {
							remote-endpoint = <0x00>;
						};
					};
				};

				panel2@1 {
					gate-ic = <0x00>;

					port {

						endpoint {
							remote-endpoint = <0x00>;
						};
					};
				};

				ports {

					port {

						endpoint {
							remote-endpoint = <0x00>;
						};
					};
				};
			};
		};

		fragment@14 {

			__overlay__ {
				pinctrl-0 = <0x00>;
				pinctrl-1 = <0x00>;
				pinctrl-2 = <0x00>;
				pinctrl-3 = <0x00>;
				pinctrl-4 = <0x00>;
				pinctrl-5 = <0x00>;
				pinctrl-6 = <0x00>;
			};
		};

		fragment@15 {

			__overlay__ {
				pinctrl-0 = <0x00>;
				pinctrl-1 = <0x00>;
				pinctrl-2 = <0x00>;
				pinctrl-3 = <0x00>;
				pinctrl-4 = <0x00>;
				pinctrl-5 = <0x00>;
			};
		};

		fragment@16 {

			__overlay__ {
				pinctrl-0 = <0x00>;
				pinctrl-1 = <0x00>;
				pinctrl-2 = <0x00>;
				pinctrl-3 = <0x00>;
				pinctrl-4 = <0x00>;
				pinctrl-5 = <0x00>;
			};
		};

		fragment@19 {

			__overlay__ {

				lm3643@63 {
					pinctrl-0 = <0x00>;
					pinctrl-1 = <0x00>;
					pinctrl-2 = <0x00>;

					flash@0 {

						port@0 {

							endpoint {
								remote-endpoint = <0x00>;
							};
						};
					};

					flash@1 {

						port@1 {

							endpoint {
								remote-endpoint = <0x00>;
							};
						};
					};
				};
			};
		};

		fragment@21 {

			__overlay__ {

				port@0 {

					endpoint {
						remote-endpoint = <0x00>;
					};
				};

				port@1 {

					endpoint {
						remote-endpoint = <0x00>;
					};
				};
			};
		};

		fragment@26 {

			__overlay__ {

				mediatek,speaker-codec {
					sound-dai = <0x00>;
				};
			};
		};

		fragment@28 {

			__overlay__ {
				pinctrl-0 = <0x00>;
			};
		};
	};
};
